## MicroPython_BUILD/components/micropython/Kconfig.projbuild
```kconfig
menu "MicroPython"
    config MICROPY_HW_BOARD_NAME
        string "Board name"
        default "ESP32 board"
        help
        Hardware board mame

    config MICROPY_HW_MCU_NAME
        string "MCU name"
        default "ESP32"
        help
        Hardware MCU mame

    config MICROPY_TIMEZONE
        string "Time zone"
        default "GMT0BST"
        help
        Set the time zone string used when updating the tome from NTP server
        You can use 'zones.csv' file to find the time zone string
        Use the second entry for your Region/city as the value set here

    menu "System settings"
		config MICRO_PY_LOG_LEVEL
		    int
		    default 0 if MICRO_PY_LOG_LEVEL0
		    default 1 if MICRO_PY_LOG_LEVEL1
		    default 2 if MICRO_PY_LOG_LEVEL2
		    default 3 if MICRO_PY_LOG_LEVEL3
		    default 4 if MICRO_PY_LOG_LEVEL4
		    default 5 if MICRO_PY_LOG_LEVEL5
		
			choice
			    prompt "Set ESP32 log level"
			    default MICRO_PY_LOG_LEVEL2
			    help
			        Select Log (debug) level
			
			    config MICRO_PY_LOG_LEVEL0
			        bool "None"
			    config MICRO_PY_LOG_LEVEL1
			        bool "Error"
			    config MICRO_PY_LOG_LEVEL2
			        bool "Warning"
			    config MICRO_PY_LOG_LEVEL3
			        bool "Info"
			    config MICRO_PY_LOG_LEVEL4
			        bool "Debug"
			    config MICRO_PY_LOG_LEVEL5
			        bool "Verbose"
			endchoice

	    config MICROPY_TASK_PRIORITY
	        int "Main task priority"
	        range 1 20
	        default 5
	        help
	        Set the priority of the main MicroPython task
	
	    config MICROPY_RX_BUFFER_SIZE
	        int "RX buffer size"
	        range 256 4096
	        default 1080
	        help
	        Set the size of the stdin RX buffer in bytes
	        Minimum of 1080 bytes must be set if you want to use YModem module
	
	    config MICROPY_STACK_SIZE
	        int "MicroPython stack size (KB)"
	        range 8 32 if !MEMMAP_SPIRAM_ENABLE
	        range 8 64 if MEMMAP_SPIRAM_ENABLE
	        default 16 if !MEMMAP_SPIRAM_ENABLE
	        default 32 if MEMMAP_SPIRAM_ENABLE
	        help
	        Set the size of the MicroPython stack in Kbytes
	
	    config MICROPY_HEAP_SIZE
	        int "MicroPython heap size (KB)"
	        range 48 128 if !MEMMAP_SPIRAM_ENABLE
	        range 1024 4096 if MEMMAP_SPIRAM_ENABLE
	        default 92 if !MEMMAP_SPIRAM_ENABLE
	        default 2048 if MEMMAP_SPIRAM_ENABLE
	        help
	        Set the size of the MicroPython heap in Kbytes
	
	    config MICROPY_USE_THREADS
	        bool "Use threads"
	        default y
	        help
	        Use _thread module
	
	    config MICROPY_THREAD_MAX_THREADS
	        int "Maximum number of threads"
	        depends on MICROPY_USE_THREADS
	        range 1 16
	        default 4
	        help
	        Set the maximum number of threads that can run simultaneosly

	    config MICROPY_THREAD_STACK_SIZE
	        int "Threads default stack size (KB)"
	        depends on MICROPY_USE_THREADS
	        range 4 32
	        default 4
	        help
	        Set the default thread stack size
	        4 KB is currently the minimum supported stack size value to guarantee
	        sufficient stack space for the interpreter itself
	
	    config MICROPY_USE_TELNET
	        bool "Enable Telnet server"
	        depends on MICROPY_USE_THREADS
	        default y
	        help
	        Enable Telnet server and REPL over telnet
	
    endmenu

    menu "Modules"
	    config MICROPY_PY_FRAMEBUF
	        bool "Enable framebuffer"
	        default n
	        help
	        Include framebuffer module into build
	
	    config MICROPY_PY_BTREE
	        bool "Include Btree"
	        default n
	        help
	        Include Btree module into build
	
	    config MICROPY_USE_WEBSOCKETS
	        bool "Use Websockets"
	        default n
	        help
	        Include websockets module into build
	
	    config MICROPY_USE_CURL
	        bool "Use Curl module"
	        default n
	        help
	        Include CURL module into build
	        Using CURLmodule will add ~400KB to your code size
	
	    config MICROPY_USE_FTP
	        bool "FTP support in Curl module"
	        depends on MICROPY_USE_CURL
	        default n
	        help
	        Include Ftp support in Curl module
	
	    config MICROPY_USE_SSH
	        bool "Use SSH module"
	        default n
	        help
	        Include SSH module into build
	
	    config MICROPY_USE_MQTT
	        bool "Use Mqtt module"
	        default n
	        help
	        Include Mqtt module into build
	
	    menu "MQTT Configuration"
	        depends on MICROPY_USE_MQTT
		    config MQTT_PROTOCOL_311
		        bool "Use protocol version 3.1.1"
		        default y
		        help
			        Use protocol version 3.1.1
			        If not set, protocol version 3.1.0 is used

		    config MQTT_PRIORITY
		        int "MQTT task priority"
		        default MICROPY_TASK_PRIORITY
		        range 1 20
		        help
			        FreeRTOS task priority of the Mqtt task
			        Default is MicroPython task priority

		    config MQTT_BUFFER_SIZE_BYTE
		        int "MQTT send/receive buffer size"
		        default 256
		        range 256 2048
		        help
			        Send/Receive buffer size in bytes
			        More than buffer size bytes can be received...
			        Publish payload size is limited to this size.
			        Keep in mind that 4*CONFIG_MQTT_BUFFER_SIZE_BYTE queue buffer will also be created.

		    config MQTT_MAX_PAYLOAD_SIZE
		        int "MQTT max payload size"
		        default 2048
		        range MQTT_BUFFER_SIZE_BYTE 16384
		        help
			        Maximum payload size which can be received
			        If the payload size is larger, it will be truncated

			config MQTT_LOG_LEVEL
			    int
			    default 0 if MQTT_LOG_LEVEL0
			    default 1 if MQTT_LOG_LEVEL1
			    default 2 if MQTT_LOG_LEVEL2
			    default 3 if MQTT_LOG_LEVEL3
			    default 4 if MQTT_LOG_LEVEL4
			
				choice
				    prompt "Set Mqtt log level"
				    default MQTT_LOG_LEVEL1
				    help
				        Select Log (debug) level
				
				    config MQTT_LOG_LEVEL0
				        bool "None"
				    config MQTT_LOG_LEVEL1
				        bool "Error"
				    config MQTT_LOG_LEVEL2
				        bool "Warning"
				    config MQTT_LOG_LEVEL3
				        bool "Info"
				    config MQTT_LOG_LEVEL4
				        bool "Debug"
				endchoice

	    endmenu
	endmenu
    menu "File systems"
        config MICROPY_USE_SPIFFS
            bool "Use SPIFFS"
            default n
            help
            Use spiffs on spi Flash instead of FatFS

        config MICROPY_INTERNALFS_START
            hex "Start address of the Flash partition"
            range 0x180000 0x1FF8000
            default 0x180000
            help
            Starting address of the Flash partition to be used as internal filesystem area
            Use hexadecimal format with leading 0x
            The starting address must be greter then MicroPython partition end
            configured in 'partitions_mpy.csv'

        config MICROPY_INTERNALFS_SIZE
            int "Filesystem size (KB)"
            range 512 14336
            default 1024
            help
            File sistem size in KB (Kbytes), minimum is 1s 512K
            Set the size in 4KB increments !

        config MICROPY_INTERNALFS_ENCRIPTED
            bool "Use encripted filesystem"
            depends on !MICROPY_USE_SPIFFS
            default n
            help
            Use encription on internal file system
            Warning: this function is still UNTESTED

        config MICROPY_FATFS_MAX_OPEN_FILES
            int "Maximum number of opened files"
            range 4 24
            default 6
            help
            Maximum number of opened files

        config MICROPY_SDMMC_SHOW_INFO
            bool "Show SDCard/SPIFFS info"
            default y
            help
            Show info after initializing SD card or SPIFFS

    endmenu

    menu "SD Card configuration"
		config SDCARD_MODE
		    int
		    default 1 if SDCARD_MODE1
		    default 2 if SDCARD_MODE2
		    default 3 if SDCARD_MODE3
		
			choice
			    prompt "SD Card mode"
			    default SDCARD_MODE3
			    help
			        Select SD Card operating mode
			
			    config SDCARD_MODE1
			        bool "SPI Mode"
			        depends on !MEMMAP_SPIRAM_ENABLE 
			    config SDCARD_MODE2
			        bool "1-line SD Mode" 
			    config SDCARD_MODE3
			        bool "4-line SD Mode" 
			endchoice

        config SDCARD_CLK
            int "CLK pin"
            depends on SDCARD_MODE1
            range 1 32
            default 14
            help
            Pin used as SPI CLK

        config SDCARD_MOSI
            int "MOSI pin"
            depends on SDCARD_MODE1
            range 1 32
            default 15
            help
            Pin used as SPI MOSI

        config SDCARD_MISO
            int "MISO pin"
            depends on SDCARD_MODE1
            range 1 32
            default 2
            help
            Pin used as SPI MISO

        config SDCARD_CS
            int "CS pin"
            depends on SDCARD_MODE1
            range 1 32
            default 13
            help
            Pin used as SPI CS
    endmenu
endmenu
```

## MicroPython_BUILD/sdkconfig.defaults
```kconfig
CONFIG_ESPTOOLPY_BAUD_921600B=y
CONFIG_ESPTOOLPY_FLASHSIZE_4MB=y
CONFIG_ESPTOOLPY_AFTER_NORESET=y
CONFIG_ESP32_DEFAULT_CPU_FREQ_240=y
CONFIG_ESP32_PANIC_PRINT_HALT=y
CONFIG_FREERTOS_THREAD_LOCAL_STORAGE_POINTERS=4
CONFIG_SUPPORT_STATIC_ALLOCATION=y
CONFIG_ENABLE_STATIC_TASK_CLEAN_UP_HOOK=y
CONFIG_FATFS_LFN_HEAP=y
CONFIG_FATFS_MAX_LFN=255
CONFIG_FATFS_CODEPAGE_437=y
CONFIG_FATFS_CODEPAGE=437
CONFIG_FLASHMODE_DIO=y
CONFIG_ESPTOOLPY_FLASHMODE="dio"
CONFIG_ESPTOOLPY_FLASHFREQ_40M=y
CONFIG_ESPTOOLPY_FLASHFREQ="40m"
CONFIG_LWIP_SO_REUSE=y
CONFIG_TCPIP_TASK_STACK_SIZE=4096
CONFIG_FREERTOS_ISR_STACKSIZE
CONFIG_FREERTOS_ISR_STACKSIZE=4096
CONFIG_TIMER_TASK_STACK_DEPTH=2048
CONFIG_FREERTOS_CHECK_STACKOVERFLOW_CANARY=y
CONFIG_ESP32_PHY_INIT_DATA_IN_PARTITION=y
```

## esp-idf_BUILD/sdkconfig.defaults
```kconfig
CONFIG_SUPPORT_STATIC_ALLOCATION y
CONFIG_ENABLE_STATIC_TASK_CLEAN_UP_HOOK y
CONFIG_MEMMAP_SPIRAM_ENABLE y
CONFIG_SPIRAM_CACHE_WORKAROUND y
```
